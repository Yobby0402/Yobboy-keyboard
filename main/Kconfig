## main/Kconfig
```kconfig
menu "Keyboard Configuration"

    menu "General key number define"
        config KEY_Q_NUM
            int "Key number of the Q button."
            default 63
            range 1 79

        config KEY_W_NUM
            int "Key number of the W button."
            default 62
            range 1 79

        config KEY_E_NUM
            int "Key number of the E button."
            default 61
            range 1 79

        config KEY_R_NUM
            int "Key number of the R button."
            default 70
            range 1 79

        config KEY_T_NUM
            int "Key number of the T button."
            default 69
            range 1 79

        config KEY_Y_NUM
            int "Key number of the Y button."
            default 68
            range 1 79

        config KEY_U_NUM
            int "Key number of the U button."
            default 67
            range 1 79

        config KEY_I_NUM
            int "Key number of the I button."
            default 74
            range 1 79

        config KEY_O_NUM
            int "Key number of the O button."
            default 73
            range 1 79

        config KEY_P_NUM
            int "Key number of the P button."
            default 79
            range 1 79

        config KEY_A_NUM
            int "Key number of the A button."
            default 58
            range 1 79

        config KEY_S_NUM
            int "Key number of the S button."
            default 60
            range 1 79

        config KEY_D_NUM
            int "Key number of the D button."
            default 59
            range 1 79

        config KEY_F_NUM
            int "Key number of the F button."
            default 71
            range 1 79

        config KEY_G_NUM
            int "Key number of the G button."
            default 72
            range 1 79

        config KEY_H_NUM
            int "Key number of the H button."
            default 65
            range 1 79

        config KEY_J_NUM
            int "Key number of the J button."
            default 66
            range 1 79

        config KEY_K_NUM
            int "Key number of the K button."
            default 75
            range 1 79

        config KEY_L_NUM
            int "Key number of the L button."
            default 76
            range 1 79

        config KEY_Z_NUM
            int "Key number of the Z button."
            default 7
            range 1 79

        config KEY_X_NUM
            int "Key number of the X button."
            default 6
            range 1 79

        config KEY_C_NUM
            int "Key number of the C button."
            default 5
            range 1 79

        config KEY_V_NUM
            int "Key number of the V button."
            default 12
            range 1 79

        config KEY_B_NUM
            int "Key number of the B button."
            default 11
            range 1 79

        config KEY_N_NUM
            int "Key number of the N button."
            default 10
            range 1 79

        config KEY_M_NUM
            int "Key number of the M button."
            default 9
            range 1 79

        config KEY_SPACE_NUM
            int "Key number of the SPACE button."
            default 4
            range 1 79

        config KEY_ENTER_NUM
            int "Key number of the ENTER button."
            default 17
            range 1 79

        config KEY_ESCAPE_NUM
            int "Key number of the ESCAPE button."
            default 50
            range 1 79

        config KEY_CAPS_LOCK_NUM
            int "Key number of the CAPS_LOCK button."
            default 57
            range 1 79

        config KEY_TAB_NUM
            int "Key number of the TAB button."
            default 64
            range 1 79

        config KEY_SEMICOLON_NUM
            int "Key number of the SEMICOLON(;) button."
            default 77
            range 1 79

        config KEY_APOSTROPHE_NUM
            int "Key number of the APOSTROPHE(') button."
            default 20
            range 1 79

        config KEY_GRAVE_NUM
            int "Key number of the GRAVE(~) button."
            default 54
            range 1 79

        config KEY_COMMA_NUM
            int "Key number of the COMMA(,) button."
            default 16
            range 1 79

        config KEY_PERIOD_NUM
            int "Key number of the PERIOD(.) button."
            default 15
            range 1 79

        config KEY_SLASH_NUM
            int "Key number of the SLASH(/) button."
            default 19
            range 1 79
        
        config KEY_BACKSLASH_NUM
            int "Key number of the BACKSLASH(\) button."
            default 30
            range 1 79
        
        config KEY_BRACKET_LEFT_NUM
            int "Key number of the BACKSLASH([) button."
            default 78
            range 1 79
        
        config KEY_BRACKET_RIGHT_NUM
            int "Key number of the BACKSLASH(]) button."
            default 29
            range 1 79
        
        config KEY_F1_NUM
            int "Key number of the F1 button."
            default 51
            range 1 79

        config KEY_F2_NUM
            int "Key number of the F2 button."
            default 50
            range 1 79

        config KEY_F3_NUM
            int "Key number of the F3 button."
            default 49
            range 1 79

        config KEY_F4_NUM
            int "Key number of the F4 button."
            default 44
            range 1 79

        config KEY_F5_NUM
            int "Key number of the F5 button."
            default 43
            range 1 79

        config KEY_F6_NUM
            int "Key number of the F6 button."
            default 42
            range 1 79

        config KEY_F7_NUM
            int "Key number of the F7 button."
            default 41
            range 1 79

        config KEY_F8_NUM
            int "Key number of the F8 button."
            default 46
            range 1 79

        config KEY_F9_NUM
            int "Key number of the F9 button."
            default 35
            range 1 79

        config KEY_F10_NUM
            int "Key number of the F10 button."
            default 34
            range 1 79

        config KEY_F11_NUM
            int "Key number of the F11 button."
            default 33
            range 1 79

        config KEY_F12_NUM
            int "Key number of the F12 button."
            default 27
            range 1 79
        
        config KEY_ARROW_LEFT_NUM
            int "Key number of the ARROW LEFT."
            default 21
            range 1 79
        
        config KEY_ARROW_DOWN_NUM
            int "Key number of the ARROW DOWN."
            default 22
            range 1 79
        
        config KEY_ARROW_RIGHT_NUM
            int "Key number of the ARROW RIGHT."
            default 23
            range 1 79
        
        config KEY_ARROW_UP_NUM
            int "Key number of the ARROW UP."
            default 24
            range 1 79
        
        config KEY_1_NUM
            int "Key number of the 1 button."
            default 53
            range 1 79
        
        config KEY_2_NUM
            int "Key number of the 2 button."
            default 56
            range 1 79
        
        config KEY_3_NUM
            int "Key number of the 3 button."
            default 55
            range 1 79
        
        config KEY_4_NUM
            int "Key number of the 4 button."
            default 46
            range 1 79
        
        config KEY_5_NUM
            int "Key number of the 5 button."
            default 45
            range 1 79
        
        config KEY_6_NUM
            int "Key number of the 6 button."
            default 48
            range 1 79
        
        config KEY_7_NUM
            int "Key number of the 7 button."
            default 47
            range 1 79
        
        config KEY_8_NUM
            int "Key number of the 8 button."
            default 38
            range 1 79
        
        config KEY_9_NUM
            int "Key number of the 9 button."
            default 37
            range 1 79
        
        config KEY_0_NUM
            int "Key number of the 0 button."
            default 40
            range 1 79
        
        config KEY_MINUS_NUM
            int "Key number of the -_ button."
            default 39
            range 1 79
            
        config KEY_EQUAL_NUM
            int "Key number of the += button."
            default 28
            range 1 79
            
        config KEY_BACKSPACE_NUM
            int "Key number of the BACKSPACE."
            default 31
            range 1 79
        
        config KEY_DELETE_NUM
            int "Key number of the DELETE."
            default 32
            range 1 79
        
        config KEY_INSERT_NUM
            int "Key number of the INSERT."
            default 25
            range 1 79
            
    endmenu

    menu "Modifier key number define"
        config KEY_LEFT_CTRL_NUM
            int "Key number of the left ctrl button."
            default 3
            range 1 79
        config KEY_LEFT_SHIFT_NUM
            int "Key number of the left shift button."
            default 8
            range 1 79
        config KEY_LEFT_ALT_NUM
            int "Key number of the left alt button."
            default 1
            range 1 79
        config KEY_LEFT_GUI_NUM
            int "Key number of the left gui button."
            default 2
            range 1 79
        config KEY_RIGHT_CTRL_NUM
            int "Key number of the right ctrl button."
            default 13
            range 1 79
        config KEY_RIGHT_SHIFT_NUM
            int "Key number of the right shift button."
            default 18
            range 1 79
        config KEY_RIGHT_ALT_NUM
            int "Key number of the right alt button."
            default 14
            range 1 79
        config KEY_RIGHT_GUI_NUM
            int "Key number of the right GUI button."
            default 0
            range 0 79
    endmenu

    menu "Fn key number"
        config KEY_FN_NUM
            int "Key number of the Fn button."
            default 26
            range 1 79
    endmenu

    menu "Function key number"
        config KEY_HOME_NUM
            int "Key number of the HOME button.(When pressed Fn)"
            default 21
            range 0 79

        config KEY_PAGE_DOWN_NUM
            int "Key number of the PAGE_DOWN button.(When pressed Fn)"
            default 22
            range 0 79

        config KEY_END_NUM
            int "Key number of the END button.(When pressed Fn)"
            default 23
            range 0 79

        config KEY_PAGE_UP_NUM
            int "Key number of the PAGE_up button.(When pressed Fn)"
            default 24
            range 0 79

        config KEY_KEYPAD_1_NUM
            int "Key number of the KEYPAD_1 button.(When pressed Fn)"
            default 53
            range 0 79

        config KEY_KEYPAD_2_NUM
            int "Key number of the KEYPAD_2 button.(When pressed Fn)"
            default 56
            range 0 79

        config KEY_KEYPAD_3_NUM
            int "Key number of the KEYPAD_3 button.(When pressed Fn)"
            default 55
            range 0 79

        config KEY_KEYPAD_4_NUM
            int "Key number of the KEYPAD_4 button.(When pressed Fn)"
            default 46
            range 0 79

        config KEY_KEYPAD_5_NUM
            int "Key number of the KEYPAD_5 button.(When pressed Fn)"
            default 45
            range 0 79

        config KEY_KEYPAD_6_NUM
            int "Key number of the KEYPAD_6 button.(When pressed Fn)"
            default 48
            range 0 79

        config KEY_KEYPAD_7_NUM
            int "Key number of the KEYPAD_7 button.(When pressed Fn)"
            default 47
            range 0 79

        config KEY_KEYPAD_8_NUM
            int "Key number of the KEYPAD_8 button.(When pressed Fn)"
            default 38
            range 0 79

        config KEY_KEYPAD_9_NUM
            int "Key number of the KEYPAD_9 button.(When pressed Fn)"
            default 37
            range 0 79

        config KEY_KEYPAD_0_NUM
            int "Key number of the KEYPAD_0 button.(When pressed Fn)"
            default 40
            range 0 79
        config KEY_KEYPAD_SUBTRACT_NUM
            int "Key number of the KEYPAD SUBTRACT button.(When pressed Fn)"
            default 39
            range 0 79
        config KEY_KEYPAD_ADD_NUM
            int "Key number of the KEYPAD ADD button.(When pressed Fn)"
            default 28
            range 0 79
        config KEY_KEYPAD_DIVIDE_NUM
            int "Key number of the KEYPAD Divide button.(When pressed Fn)"
            default 19
            range 0 79
    endmenu

    menu "Consumer control key number"
        config KEY_MUTE_BUTTON_NUM
            int "Key number of the dedicated mute button."
            default 0
            range 0 79
            help
                Set to 0 if there is no dedicated mute key on the PCB.

        config KEY_VOLUME_UP_BUTTON_NUM
            int "Key number of the dedicated volume up button."
            default 0
            range 0 79
            help
                Set to 0 if there is no dedicated volume up key on the PCB.

        config KEY_VOLUME_DOWN_BUTTON_NUM
            int "Key number of the dedicated volume down button."
            default 0
            range 0 79
            help
                Set to 0 if there is no dedicated volume down key on the PCB.
    endmenu
endmenu

menu "HC165 Key Scan Configuration"
    choice HC165_READ_MODE
        prompt "HC165 Read Mode"
        default HC165_MODE_GPIO
        help
            Select the method to read HC165 shift register data.
            - GPIO Mode: Simple GPIO bit-banging (slow but compatible)
            - Optimized GPIO: Optimized GPIO without delays (3-4x faster)
            - Hardware SPI: Use ESP32-S3 SPI peripheral (16-20x faster, needs SPI pins)

        config HC165_MODE_GPIO
            bool "GPIO Mode (Original)"
            help
                Original GPIO bit-banging method with delays.
                Speed: ~320us for 80 keys
                Pros: Simple, compatible with any GPIO pins
                Cons: Slower, higher CPU usage

        config HC165_MODE_GPIO_OPTIMIZED
            bool "Optimized GPIO Mode"
            help
                Optimized GPIO mode with reduced delays and register operations.
                Speed: ~80-100us for 80 keys (3-4x faster)
                Pros: Fast, no hardware changes needed
                Cons: Still uses CPU for bit-banging

        config HC165_MODE_HARDWARE_SPI
            bool "Hardware SPI Mode"
            help
                Use ESP32-S3 hardware SPI peripheral (SPI2 or SPI3).
                Speed: ~15-20us for 80 keys (16-20x faster)
                Pros: Fastest, very low CPU usage, precise timing
                Cons: Requires SPI-compatible GPIO pins, occupies one SPI peripheral
    endchoice

    config HC165_PIN_DATA
        int "HC165 DATA (QH) Pin"
        default 16
        range 0 48
        help
            GPIO pin connected to HC165 serial data output (QH pin).
            For Hardware SPI mode, this should be a valid MISO pin.

    config HC165_PIN_CLK
        int "HC165 CLK (Clock) Pin"
        default 17
        range 0 48
        help
            GPIO pin connected to HC165 clock input (CLK pin).
            For Hardware SPI mode, this should be a valid SCLK pin.

    config HC165_PIN_SHLD
        int "HC165 SH/LD (Shift/Load) Pin"
        default 18
        range 0 48
        help
            GPIO pin connected to HC165 parallel load control (SH/LD pin).
            This pin is always controlled as regular GPIO.

    config HC165_SPI_HOST
        int "SPI Host (2 or 3)"
        depends on HC165_MODE_HARDWARE_SPI
        default 2
        range 2 3
        help
            Select which SPI peripheral to use:
            2 = SPI2_HOST
            3 = SPI3_HOST
            Note: SPI1 is reserved for flash

    config HC165_SPI_FREQ_MHZ
        int "SPI Clock Frequency (MHz)"
        depends on HC165_MODE_HARDWARE_SPI
        default 10
        range 1 20
        help
            SPI clock frequency in MHz.
            Higher frequency = faster read, but may be unstable.
            Recommended: 10MHz for stable operation.

    config HC165_NUM_KEYS
        int "Number of keys (8 x number of HC165 chips)"
        default 80
        range 8 256
        help
            Total number of keys to scan.
            Should be 8 x (number of HC165 chips in chain).
            Example: 10 HC165 chips = 80 keys

endmenu

menu "Application Mode"
    config LED_STRIP_TEST_APP
        bool "Enable standalone LED strip test firmware"
        help
            Build a minimal firmware that skips USB/keyboard logic and simply
            exercises the LED strip. Use this to validate hardware wiring.

    config LED_TEST_NUM_LEDS
        int "Number of LEDs on test strip"
        default 78
        range 1 512
        help
            Total number of LEDs physically connected in the test setup.

    config LED_TEST_GPIO
        int "LED test data GPIO"
        default 15
        range 0 48
        help
            GPIO pin that drives the LED strip data line during the test.

    config LED_TEST_BRIGHTNESS
        int "LED test brightness (0-255)"
        default 64
        range 1 255
        help
            Global brightness applied to all test colors (0-255). Lower values
            reduce current draw.

    config LED_TEST_PATTERN_DELAY_MS
        int "LED test pattern dwell time (ms)"
        default 1000
        range 50 10000
        help
            How long each solid color stays active before switching.

    config LED_TEST_USE_DMA
        bool "Use DMA for LED test output"
        default y
        help
            Enable DMA transfers for the LED test RMT driver (recommended).
endmenu

menu "LED Configuration"
    config KEY_LED_SWITCH_NUM
        int "LED switch key number"
        default 27

    config LED_POWER_ON_FADE_STEPS
        int "LED power-on fade steps"
        default 30
        range 1 255
        help
            Number of refresh cycles used to gradually brighten the LEDs
            when turning them on. Higher values mean a longer fade-in that
            can reduce inrush current.

    config KEY_LED_ADD_NUM
        int "Key number of the led brightness add button.(When pressed Fn)"
        default 32
        range 0 79

    config KEY_LED_SUB_NUM
        int "Key number of the led brightness sub button.(When pressed Fn)"
        default 31
        range 0 79

    config KEY_LED_EFFECT_NUM
        int "Key number of the led effect switch button.(When pressed Fn)"
        default 25
        range 0 79

    config LED_STRIP_BLINK_GPIO
        int "LED Strip GPIO number"
        default 15
    
    config LED_STRIP_LED_NUMBERS
        int "LED number on the bus"
        default 79
    
    config LED_STRIP_RMT_RES_HZ
        int "LED STRIP RMT RES MHZ"
        default 10
    
    config LED_RAINBOW_HUE_INCREMENT
        int "Adjust this value to control the speed of the rainbow effect"
        default 1
    
    config LED_BREATHING_SPEED
        int "Adjust this value to control the speed of the breathing effect"
        default 75

        config LED_SWITCH_SLEEP
            int "How much time you want to delay after switch led state in ms"
            default 1000

    menu "LED Performance Configuration"
        config LED_STRIP_USE_DMA
            bool "Enable DMA for LED Strip (Recommended)"
            default y
            help
                Enable DMA for LED strip operations to reduce CPU usage.
                This significantly improves performance (60% less CPU usage).
                Recommended for all users unless you have specific DMA conflicts.
        
        config LED_STRIP_REFRESH_RATE
            int "LED Strip refresh rate (Hz)"
            default 100
            range 50 200
            help
                LED strip refresh rate in Hz.
                Higher values provide smoother animations but increase CPU usage.
                - 50 Hz: Low power mode
                - 100 Hz: Standard (recommended)
                - 150 Hz: High performance
                - 200 Hz: Maximum smoothness (requires DMA)
    endmenu

    menu "NVS Storage Configuration"
        config NVS_STORAGE_ENABLE
            bool "Enable NVS Storage for Settings"
            default y
            help
                Save keyboard settings to NVS (Non-Volatile Storage).
                Settings will be restored after power cycle.
                This includes LED brightness, effects, and other configurations.
        
        config NVS_SAVE_LED_SETTINGS
            bool "Save LED settings to NVS"
            default y
            depends on NVS_STORAGE_ENABLE
            help
                Save LED brightness, state, and effect to NVS.
                Settings will be restored on next boot.
        
        config NVS_SAVE_VOLUME_SETTINGS
            bool "Save volume control settings to NVS"
            default y
            depends on NVS_STORAGE_ENABLE
            help
                Save volume step configuration to NVS.
        
        config NVS_AUTO_SAVE_DELAY
            int "Auto-save delay (seconds)"
            default 5
            range 1 60
            depends on NVS_STORAGE_ENABLE
            help
                Delay before auto-saving settings after changes.
                This prevents excessive writes to flash memory.
                Lower values save faster but may reduce flash lifetime.
    endmenu

endmenu
```
